## package/mtk/applications/mtwifi-scripts/Config.in
```kconfig
config WIFI_SCRIPTS_UCODE
	bool
	default y if PACKAGE_mtwifi-scripts

config WIFI_SCRIPTS_WPS_BUTTON_DISABLED
	bool
	prompt "Disable WPS button handling"
	default n
	help
		If set, the WPS button handling logic in /etc/rc.button/wps is disabled.
```
